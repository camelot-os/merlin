## Kconfig
```kconfig
# SPDX-License-Identifier: Apache-2.0
# Copyright (c) 2026 H2Lab Development Team

menuconfig WITH_MERLIN
    bool "enable Merlin device framework"

if WITH_MERLIN

config MAX_REGISTERED_DRIVERS
    int "maximum number of device drivers that can be registered"
    range 0 8
    default 4

endif
```
